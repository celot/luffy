## src/v741/config.in
```kconfig
mainmenu_option next_comment

define_bool CONFIG_JP_DEALER_HITACHI y

comment 'Select Model'
choice 'Model' "CPRN_KLW CONFIG_CPRN_KLW
                      CPRW_KLW CONFIG_CPRW_KLW
			 CPRN_NLW CONFIG_CPRN_NLW
			 CPRW_NLW CONFIG_CPRW_NLW
			 CPRN_NLW2 CONFIG_CPRN_NLW2
			 CPRW_NLW2 CONFIG_CPRW_NLW2" CPRN_KLW
endmenu

if [ "$CONFIG_CPRN_KLW" = "y" -o "$CONFIG_CPRW_KLW" = "y" ]; then
 define_bool CONFIG_MODEM_KDDI y
else
 define_bool CONFIG_MODEM_PANTECH y
fi

mainmenu_option next_comment

comment 'Select Service'
bool 'GPS service'		CONFIG_SERVICE_GPS
bool 'MODBUS service'               CONFIG_SERVICE_MODBUS
bool 'FailSafe service'               CONFIG_SERVICE_FAILSAFE
bool 'APN Domain White list'               CONFIG_SERVICE_APN_DWL
bool 'WiFi Hotspot service'		CONFIG_SERVICE_WIFI_HOTSPOT
	if [ "$CONFIG_SERVICE_WIFI_HOTSPOT" = "y" ]; then
	    mainmenu_option next_comment
	        comment '    Auth'
	        bool 'Self Auth'	CONFIG_SERVICE_WIFI_HOTSPOT_LOCAL
	    endmenu
	fi
endmenu



mainmenu_option next_comment

comment 'Additional Features'
bool 'Use remote Syslog'		CONFIG_USE_REMOTE_SYSLOG
endmenu

mainmenu_name 'Ralink Embedded Linux Configuration'
mainmenu_option next_comment
comment 'Select the Product you wish to target'
choice 'Ralink Products' "RT2880 CONFIG_DEFAULTS_RALINK_RT2880\
                           RT3052 CONFIG_DEFAULTS_RALINK_RT3052\
                           RT3352 CONFIG_DEFAULTS_RALINK_RT3352\
                           RT3883 CONFIG_DEFAULTS_RALINK_RT3883\
                           RT5350 CONFIG_DEFAULTS_RALINK_RT5350\
                           RT6855A CONFIG_DEFAULTS_RALINK_RT6855A\
                         " RT3352
if [ "$CONFIG_DEFAULTS_RALINK_RT2880" = "y" ]; then
choice   'Default Configuration File'\
         "2M/16M   CONFIG_DEFSETTING_2M16M\
           4M/16M   CONFIG_DEFSETTING_4M16M\
	  "
elif [ "" = "y" ]; then
choice   'Default Configuration File'\
         "4M/32M(AP+NAS)	  CONFIG_DEFSETTING_4M32M\
           8M/64M(AP+STA)	  CONFIG_DEFSETTING_8M64M\
	  "
elif [ "$CONFIG_DEFAULTS_RALINK_RT3352" = "y" ]; then
choice   'Default Configuration File'\
         "2M/16M(AP)	  CONFIG_DEFSETTING_2M16M\
           4M/32M(AP+NAS)	  CONFIG_DEFSETTING_4M32M\
	  "
elif [ "$CONFIG_DEFAULTS_RALINK_RT5350" = "y" ]; then
choice   'Default Configuration File'\
         "2M/16M(AP)	  CONFIG_DEFSETTING_2M16M\
           4M/32M(AP+NAS)	  CONFIG_DEFSETTING_4M32M\
	  "
elif [ "$CONFIG_DEFAULTS_RALINK_RT6855A" = "y" ]; then
choice   'Default Configuration File'\
         "RT6855/6+AP(4M/32M)	CONFIG_DEFSETTING_4M32M\
           RT6855/6+NAS(8M/32M)	CONFIG_DEFSETTING_8M32M\
           RT6855/6+FULL(8M/64M)	CONFIG_DEFSETTING_8M64M\
	  "
else
choice   'Default Configuration File'\
         "2M/16M(AP)	  CONFIG_DEFSETTING_2M16M\
           4M/32M(AP+NAS)   CONFIG_DEFSETTING_4M32M\
	  "
fi
endmenu
mainmenu_option next_comment
comment 'Kernel/Library/Defaults Selection'
if [ "$CONFIG_DEFAULTS_RALINK_RT2880" = "y" ]; then
 define_bool CONFIG_DEFAULTS_KERNEL_2_4 y
elif [ "$CONFIG_DEFAULTS_RALINK_RT6855A" = "y" ]; then
 define_bool CONFIG_DEFAULTS_KERNEL_2_6_36MT y
else
 define_bool CONFIG_DEFAULTS_KERNEL_2_6_21 y
fi
string 'Cross Compiler Path' 			CONFIG_CROSS_COMPILER_PATH /opt/buildroot-gcc342/bin
comment ' '
bool 'Default all settings (lose changes)'	CONFIG_DEFAULTS_OVERRIDE
bool 'Customize Kernel Settings'		CONFIG_DEFAULTS_KERNEL
bool 'Customize Vendor/User Settings'		CONFIG_DEFAULTS_VENDOR
bool 'Customize Busybox Settings'               CONFIG_DEFAULTS_BUSYBOX
bool 'Customize uClibc Settings'                CONFIG_DEFAULTS_UCLIBC
bool 'Customize uClibc++ Settings'              CONFIG_DEFAULTS_UCLIBC_PLUS_PLUS
bool 'Update Default Vendor Settings'		CONFIG_DEFAULTS_VENDOR_UPDATE
endmenu
```

## src/v741/linux-2.6.21.x/celot/Kconfig
```kconfig
menu "Celot Configuration"

config  CELOT
        bool "Celot config"
        default y

config CELOT_MTD
        bool "Use System MTD"
        default y if CELOT

choice
	 prompt "Flash size" if CELOT_MTD
        default CELOT_MTD_8M
        depends on CELOT_MTD
        
	config  CELOT_MTD_8M
	bool "8M Flash"

	config  CELOT_MTD_16M
	bool "16M Flash"
endchoice	

config CELOT_GPIO
        bool "Use GPIO Control"
        default y if CELOT

config CELOT_USB
        bool "Use Celot USB"
        default y if CELOT

config CELOT_SERIAL
        bool "Use Celot SERIAL"
        default y if CELOT

endmenu
```
